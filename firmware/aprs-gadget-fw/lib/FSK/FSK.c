#include <avr/io.h>
#include <avr/interrupt.h>
#include <FSK.h>

const uint8_t sine[198] = {
    0x7F,0x83,0x87,0x8B,0x8F,0x93,0x97,0x9B,0x9F,0xA3,0xA7,
    0xAB,0xAF,0xB2,0xB6,0xBA,0xBD,0xC1,0xC4,0xC8,0xCB,0xCE,
    0xD1,0xD4,0xD7,0xDA,0xDD,0xE0,0xE2,0xE5,0xE7,0xEA,0xEC,
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    0x53,0x57,0x5B,0x5F,0x63,0x67,0x6B,0x6F,0x73,0x77,0x7B
};

static volatile bool FSK_bit = false;
static volatile bool EOP = false;

ISR(TIMER1_OVF_vect){

    static uint8_t dds_idx = 0;
    static uint8_t period = 0;

    OCR1AH = 0;
    OCR1AL = sine[dds_idx];
    
    if(FSK_bit == true){
        dds_idx += 6;
    }else{
        dds_idx += 11;
    }

    if(dds_idx > 197){
        dds_idx -= 198;
    }

    period++;
    if(period==33){
        period = 0;
        EOP = true;
    }
}

void FSK_init(void){
    DDRB = _BV(DDB1); //set PD9 as output (OC1A)
    
    TCNT1H = 0;     //reset timer
    TCNT1L = 0;

    TCCR1A = _BV(COM1A1) | _BV(WGM11); // Clear OC1A on compare match, Fast PWM mode, ICR1 as TOP
    TCCR1B = _BV(WGM13) | _BV(WGM12);

    OCR1AH = 0;     //load first value to compare to
    OCR1AL = sine[0];

#if F_CPU == 16000000L
    ICR1H = 0x01;   //load TOP value: 403 for 39.6kHz PWM
    ICR1L = 0x93;
#elif F_CPU == 12000000L
    ICR1H = 0x01;   //load TOP value: 302 for 39.6kHz PWM
    ICR1L = 0x2E;
#else
    #error Specified CPU frequency not supported
#endif

    TIMSK1 = _BV(TOIE1); //enable overflow interrupt
    sei();  //enable global inetrrupt
}


void FSK_start(void){
    TCCR1B |= _BV(CS00); //enable timer1 with no prescaler
}

void FSK_setbit(bool bit){
    while(!EOP);
    FSK_bit = bit;
    EOP = false;
}

void FSK_stop(void){
    TCCR1B &= ~_BV(CS00);
    PORTB &= ~_BV(PB1);
}